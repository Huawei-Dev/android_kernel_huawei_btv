## arch/arm64/kvm/Kconfig
```kconfig
#
# KVM configuration
#

source "virt/kvm/Kconfig"

menuconfig VIRTUALIZATION
	bool "Virtualization"
	---help---
	  Say Y here to get to see options for using your Linux host to run
	  other operating systems inside virtual machines (guests).
	  This option alone does not add any kernel code.

	  If you say N, all options in this submenu will be skipped and
	  disabled.

if VIRTUALIZATION

config KVM_ARM_VGIC_V3
	bool

config KVM
	bool "Kernel-based Virtual Machine (KVM) support"
	depends on OF
	depends on !ARM64_16K_PAGES
	select MMU_NOTIFIER
	select PREEMPT_NOTIFIERS
	select HAVE_KVM_CPU_RELAX_INTERCEPT
	select HAVE_KVM_ARCH_TLB_FLUSH_ALL
	select KVM_MMIO
	select KVM_ARM_HOST
	select KVM_GENERIC_DIRTYLOG_READ_PROTECT
	select SRCU
	select HAVE_KVM_EVENTFD
	select HAVE_KVM_IRQFD
	select KVM_ARM_VGIC_V3
	---help---
	  Support hosting virtualized guest machines.
	  We don't support KVM with 16K page tables yet, due to the multiple
	  levels of fake page tables.

	  If unsure, say N.

config KVM_ARM_HOST
	bool
	---help---
	  Provides host support for ARM processors.

config KVM_ARM_MAX_VCPUS
	int "Number maximum supported virtual CPUs per VM"
	depends on KVM_ARM_HOST
	default 4
	help
	  Static number of max supported virtual CPUs per VM.

	  If you choose a high number, the vcpu structures will be quite
	  large, so only choose a reasonable number that you expect to
	  actually use.

endif # VIRTUALIZATION
```

## drivers/hisi/ddrc/Kconfig
```kconfig
config HISILICON_PLATFORM_DDRC
	bool "Hisilicon platform ddr controller support"
	default n
	help
	  Say yes here to support the hisilicon platform ddr controller

      
config HISI_DDRC_SEC
	bool "hisi ddr secprotect"
	default n
```

## drivers/hisi/hisi_lmk/Kconfig
```kconfig
menu "Hisi lowmem killer"

config HISI_LOWMEM
	bool "Hisilicon Low Memory Killer"
	default n
	depends on ANDROID_LOW_MEMORY_KILLER
	help
	  Enables hisi lowmem killer parameter tuning

config HISI_LOWMEM_DBG
	bool "Hisilicon Low Memory Killer debug"
	default n
	depends on ANDROID_LOW_MEMORY_KILLER
	help
	  print processes info when lmk happen per several seconds

endmenu
```

## drivers/huawei_platform/emcom/Kconfig
```kconfig
menuconfig HUAWEI_EMCOM
    bool "Huawei emcom feature support"
    default n
    help
    Say yes here to support emcom feature

if HUAWEI_EMCOM
source "drivers/huawei_platform/emcom/xengine/Kconfig"
endif # if HUAWEI_EMCOM
```

## drivers/huawei_platform/usb/Kconfig
```kconfig
source "drivers/huawei_platform/usb/switch/Kconfig" 
source "drivers/huawei_platform/usb/typec/Kconfig"
```

## drivers/iommu/hisi/Kconfig
```kconfig
# Hisilicon IOMMU support

config HISI_IODOMAIN_API
	bool

config HISI_IOMMU
	bool "Hisilicon IOMMU Support"
	select IOMMU_API
	select HISI_IODOMAIN_API
	help
	  Hisilicon IOMMU Support.

config HISI_IOMMU_LEGACY
	bool "Hisilicon IOMMU SECOND LEVEL PAGE TABLE Support"
	select IOMMU_API
	depends on HISI_IOMMU && !HISI_IOMMU_LPAE
	help
	  Hisilicon IOMMU Support.
```

## drivers/mmc/Kconfig
```kconfig
#
# MMC subsystem configuration
#

menuconfig MMC
	tristate "HISI MMC/SD/SDIO card support"
	depends on HAS_IOMEM
	help
	  This selects MultiMediaCard, Secure Digital and Secure
	  Digital I/O support.

	  If you want MMC/SD/SDIO support, you should say Y here and
	  also to your specific host controller driver.

config HISI_MMC
	bool "HISI MMC"
	depends on MMC
	default n
	help
	   config HISI mmc driver

config MMC_DEBUG
	bool "MMC debugging"
	depends on MMC != n
	help
	  This is an option for use by developers; most people should
	  say N here.  This enables MMC core and driver debugging.

config MMC_PERF_PROFILING
	bool "MMC performance profiling"
	depends on MMC != n
	default n
	help
	  If you say Y here, support will be added for collecting
	  performance numbers at the MMC Queue and Host layers.

config HISI_MMC_SECURE_RPMB
       bool "MMC RPMB Security Solution"
       depends on HISI_MMC
       help
         Enable this config will change the default behavior of RPMB
         HMAC calucation will be done in secure wolrd.

if MMC

source "drivers/mmc/core/Kconfig"

source "drivers/mmc/card/Kconfig"

source "drivers/mmc/host/Kconfig"

endif # MMC
```

## drivers/power/hisi/charger/Kconfig
```kconfig
config HISI_CHARGER
	bool "hisi charger"
	default n

config SCHARGER_V300
	bool "schargerV300"
	default n
```
